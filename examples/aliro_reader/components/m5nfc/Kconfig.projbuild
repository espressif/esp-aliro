## examples/aliro_reader/components/m5nfc/Kconfig.projbuild
```kconfig
menu "ST25R3916 reader"

config ST25R3916_PIN_SDA
    int "I2C SDA GPIO"
    default 6

config ST25R3916_PIN_SCL
    int "I2C SCL GPIO"
    default 7

config ST25R3916_I2C_PORT
    int "I2C port"
    default 0

config ST25R3916_TRANSCEIVE_TIMEOUT_MS
    int "Minimum ISO-DEP frame timeout (ms)"
    range 1 60000
    default 100
    help
        Frame waiting time is the larger of this value and the peer ATS value.
        WTX extends individual waits; a whole APDU is limited to 60 seconds.

endmenu # menu "ST25R3916 reader"
```

## examples/aliro_reader/main/Kconfig.projbuild
```kconfig
menu "Aliro reader example"

menu "Aliro protocol"

config SUPPORT_FAST_TRANSACTION_PHASE
    bool "Support fast transaction phase"
    default n
    help
        Enable the expedited-fast path using a per-reader RAM cache (3 entries).
        Entries are stored or touched only after explicit application authorization
        and before the final EXCHANGE. Cache contents are lost on reboot.

config SUPPORT_KEYSLOT
    bool "Support credential public key lookup by key slot"
    default n
    help
        Allow the user device to return a credential key slot instead of the
        full credential public key. The example resolves the configured test
        credential public key from that key slot.

choice READER_CERT_POLICY
    prompt "Reader certificate delivery"
    default READER_CERT_POLICY_DO_NOT_SEND
    help
        Select how the reader certificate is used during expedited-standard
        authentication. The Aliro protocol allows the certificate to be sent
        with LOAD CERT, included in AUTH1, or omitted when the user device can
        authenticate the reader public key by other provisioned context.

    config READER_CERT_POLICY_SEND_VIA_LOAD_CERT
        bool "Send reader certificate via LOAD CERT"
        help
            Send the compressed reader certificate in a LOAD CERT command before
            AUTH1. This matches the default example flow.

    config READER_CERT_POLICY_SEND_VIA_AUTH1
        bool "Send reader certificate via AUTH1"
        help
            Include the compressed reader certificate in AUTH1 instead of sending a
            separate LOAD CERT command.

    config READER_CERT_POLICY_DO_NOT_SEND
        bool "Do not send reader certificate"
        help
            Do not send a reader certificate. Use this only when the user device can
            verify the reader signature through a previously provisioned reader key
            or equivalent installation-specific trust context.

endchoice # choice READER_CERT_POLICY

config SUPPORT_MAILBOX
    bool "Support mailbox exchange after expedited phase"
    default n
    help
        After application authorization, issue an EXCHANGE command carrying
        mailbox read/write/set requests before the normal EXCHANGE command.
        The crypto engine follows the current expedited or step-up phase.

config SUPPORT_STEPUP_PHASE
    bool "Require Access Document authorization (step-up)"
    default n
    help
        Require a verified Access Document, or a fresh verified cached decision.
        The example supports only its unconditional reader-rule profile. Fast
        authentication continues standard when the cached decision needs refresh.
        When disabled, authorize only the provisioned credential; a peer
        timestamp does not change this policy.

config EXAMPLE_DOCUMENT_VALIDATION_TIME
    int "Frozen UTC Unix time for document fixture validation"
    depends on SUPPORT_STEPUP_PHASE
    range 0 9223372036854775807
    # Generated by check_document_validation_time.py: 2027-01-01T00:00:00Z
    default 1798761600
    help
        Test only: a literal Unix timestamp, including 0 for 1970-01-01 UTC.
        Keep the default 30–365 days ahead of current UTC, within the peer
        fixture validity window. Pre-commit generates its UTC date comment.
        A frozen clock does not advance; never use it in production.

endmenu # menu "Aliro protocol"

endmenu # menu "Aliro reader example"
```

## examples/aliro_reader/sdkconfig.defaults
```kconfig
CONFIG_PARTITION_TABLE_CUSTOM=y
CONFIG_PARTITION_TABLE_CUSTOM_FILENAME="partitions.csv"

# Required by M5Unit-NFC
CONFIG_COMPILER_CXX_RTTI=y
CONFIG_COMPILER_CXX_EXCEPTIONS=y

# Required by Aliro SDK
CONFIG_MBEDTLS_PEM_PARSE_C=y
CONFIG_MBEDTLS_GCM_C=y
CONFIG_MBEDTLS_ECP_C=y
CONFIG_MBEDTLS_ECP_NIST_OPTIM=y
CONFIG_MBEDTLS_ECDH_C=y
CONFIG_MBEDTLS_ECDSA_C=y
CONFIG_MBEDTLS_PK_PARSE_EC_EXTENDED=y
CONFIG_MBEDTLS_ECP_DP_SECP256R1_ENABLED=y
CONFIG_MBEDTLS_SHA1_C=y
CONFIG_MBEDTLS_HKDF_C=y

# Code size optimization
CONFIG_MBEDTLS_FS_IO=n
CONFIG_MBEDTLS_ERROR_STRINGS=n
CONFIG_MBEDTLS_HAVE_TIME=n
CONFIG_MBEDTLS_SELF_TEST=n
CONFIG_MBEDTLS_SSL_PROTO_TLS1_3=n
CONFIG_MBEDTLS_SHA384_C=n
CONFIG_MBEDTLS_SHA512_C=n
```

## examples/aliro_reader/sdkconfig.defaults.nanoc6
```kconfig
CONFIG_ESPTOOLPY_FLASHSIZE_4MB=y

CONFIG_ST25R3916_PIN_SDA=2
CONFIG_ST25R3916_PIN_SCL=1
CONFIG_ST25R3916_I2C_PORT=0
```
